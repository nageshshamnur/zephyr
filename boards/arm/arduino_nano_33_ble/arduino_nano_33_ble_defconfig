## boards/arm/arduino_nano_33_ble/arduino_nano_33_ble_defconfig
```kconfig
# SPDX-License-Identifier: Apache-2.0

CONFIG_SOC_SERIES_NRF52X=y
CONFIG_SOC_NRF52840_QIAA=y
CONFIG_BOARD_ARDUINO_NANO_33_BLE=y

# Enable MPU
CONFIG_ARM_MPU=y
CONFIG_HW_STACK_PROTECTION=y

# enable peripherals
CONFIG_GPIO=y
CONFIG_SERIAL=y
CONFIG_CONSOLE=y

# enable sam-ba bootloader on legacy mode
CONFIG_BOOTLOADER_BOSSA=y
CONFIG_BOOTLOADER_BOSSA_LEGACY=y

# additional board options
CONFIG_GPIO_AS_PINRESET=y
# Following configuration are need to enable virtual com port via USB CDC_ACM 
# and to redirct print to virtual COM port via USB CDC_ACM which can be viewed 
# via serial application such as minicom
CONFIG_USB=y
CONFIG_USB_DEVICE_STACK=y
CONFIG_USB_DEVICE_PRODUCT="zephyr application with CDC_ACM enabled"
CONFIG_USB_UART_CONSOLE=y
CONFIG_UART_LINE_CTRL=y
CONFIG_UART_CONSOLE_ON_DEV_NAME="CDC_ACM_0"
CONFIG_BOARD_ARDUINO_NANO_33_BLE_INIT_USB_CDC_ACM=y
```
